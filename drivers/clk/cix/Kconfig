## drivers/clk/cix/Kconfig
```kconfig
# SPDX-License-Identifier: GPL-2.0-only

config CLK_SKY1_AUDSS
	tristate "CIX Sky1 Audio Subsystem Clock Controller"
	depends on ARCH_CIX || COMPILE_TEST
	depends on MFD_SYSCON
	depends on COMMON_CLK
	default ARCH_CIX
	help
	  This enables the audio subsystem clock controller for CIX Sky1
	  SoCs. This is required for the audio subsystem including I2S
	  controllers and DSP.
```

## drivers/gpu/drm/sky1/Kconfig
```kconfig
config DRM_SKY1
	tristate "Sky1 GPU render node bridge"
	depends on DRM && MMU
	select DRM_GEM_SHMEM_HELPER
	help
	  Provides a DRM render node for the CIX Sky1 SoC.  The Mali GPU
	  on Sky1 uses a non-standard device interface (/dev/mali0) that
	  the Linux graphics stack cannot discover.  This module bridges
	  the gap with a standard DRM render node providing GEM buffer
	  allocation and DMA-BUF export/import (PRIME).

	  Required for hardware-accelerated OpenGL via Mesa Zink on Sky1.

	  If M is selected the module will be called sky1-drm.
```

## drivers/media/platform/cix/Kconfig
```kconfig
# SPDX-License-Identifier: GPL-2.0-only
config VIDEO_LINLON
	tristate "Linlon VPU support"
	depends on VIDEO_DEV
	select VIDEOBUF2_DMA_SG
	select VIDEOBUF2_MEMOPS
	default y
	help
	  This enables support for the Linlon VPU family.

config VIDEO_LINLON_FTRACE
	bool "Send kernel space logs to ftrace"
	depends on VIDEO_LINLON
	default n
	help
	  Send kernel space logs to ftrace.

config VIDEO_LINLON_PRINT_FILE
	bool "Append file and line number to kernel space log messages"
	depends on VIDEO_LINLON
	default y
	help
	  Append file and line number to kernel space log messages.
```

## drivers/net/ethernet/realtek/r8125/Kconfig
```kconfig
# SPDX-License-Identifier: GPL-2.0-only
config R8125
	tristate "Realtek RTL8125 PCI 2.5GbE Ethernet support"
	depends on PCI
	select CRC32
	help
	  Realtek RTL8125 PCI 2.5 Gigabit Ethernet adapter driver.

	  To compile this driver as a module, choose M here. The module
	  will be called r8125.
```

## drivers/net/ethernet/realtek/r8126/Kconfig
```kconfig
# SPDX-License-Identifier: GPL-2.0-only
config R8126
	tristate "Realtek RTL8126 PCI 5GbE Ethernet support"
	depends on PCI
	select CRC32
	help
	  Realtek RTL8126 PCI 5 Gigabit Ethernet adapter driver.

	  To compile this driver as a module, choose M here. The module
	  will be called r8126.
```

## drivers/soc/cix/Kconfig
```kconfig
# SPDX-License-Identifier: GPL-2.0-only

config CIX_SKY1_SOCINFO
	tristate "CIX Sky1 SoC information driver"
	depends on ARCH_CIX || COMPILE_TEST
	depends on NVMEM
	default ARCH_CIX
	help
	  Say yes here to enable support for the CIX Sky1 SoC information
	  driver. This provides SoC identification, firmware version
	  information, and board details via sysfs.

	  This driver can also be built as a module. If so, the module
	  will be called sky1-socinfo.

config CIX_DDR_LP
	tristate "CIX DDR Low Power control driver"
	depends on ARCH_CIX || COMPILE_TEST
	depends on HAVE_ARM_SMCCC
	default ARCH_CIX
	help
	  Say yes here to enable support for the CIX DDR low power control
	  driver. This allows enabling/disabling DDR self-refresh and power-down
	  states via SMC calls to TF-A firmware.

	  The driver exposes a sysfs interface at /sys/devices/.../on to control
	  DDR low power mode (1=enabled, 0=disabled).

	  This driver can also be built as a module. If so, the module
	  will be called cix-ddr-lp.

config CIX_ACPI_RESOURCE_LOOKUP
	bool "CIX ACPI resource lookup driver"
	depends on ARCH_CIX || COMPILE_TEST
	depends on ACPI
	depends on RESET_CONTROLLER
	default ARCH_CIX
	help
	  Processes custom CIX DSDT tables (RSTL, RSNL, DLKL) to register
	  reset control lookups, assign names to platform resources, and
	  create device link dependencies. This bridges CIX's ACPI firmware
	  with the Linux kernel's standard resource lookup mechanisms.

	  Required for CIX Sky1 ACPI boot with drivers that use
	  platform_get_resource_byname() or devm_reset_control_get().

config CIX_ACPI_USB_SCAN
	bool "CIX ACPI USB scan handler"
	depends on ARCH_CIX || COMPILE_TEST
	depends on ACPI
	default ARCH_CIX
	help
	  Block PNP0D10 (generic xHCI) platform device creation on CIX Sky1
	  so the vendor USB driver chain (cdnsp-sky1 + cdnsp-plat) can own
	  the hardware instead of xhci-plat.

	  Required for proper USB controller initialization under ACPI boot.

config CIX_BUS_PERF
	tristate "CIX Bus Performance State Control driver"
	depends on ARCH_CIX || COMPILE_TEST
	depends on PM_GENERIC_DOMAINS
	depends on PM_OPP
	default ARCH_CIX
	help
	  Say yes here to enable support for the CIX CI700/NI700 bus frequency
	  control driver. This allows controlling memory interconnect frequency
	  via SCMI performance domains.

	  The driver exposes a sysfs interface for setting bus frequency.

	  This driver can also be built as a module. If so, the module
	  will be called cix-bus-perf.
```
